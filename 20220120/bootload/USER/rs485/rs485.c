
/*
****************************************************************************************




*********************************版权所有，盗版必究*********************************
****************************************************************************************
*/

/*
****************************************************************************************
* INCLUDES (头文件包含)
****************************************************************************************
*/
#include "rs485.h"
#include "stdio.h"


/*
****************************************************************************************
* CONSTANTS (常量定义)
****************************************************************************************
*/


//使用查表法计算CRC16   高效
//CRC高位字节值表
const uint8_t auch_crc_hi[] = {
	0x00, 0xC1, 0x81, 0x40, 0x01, 0xC0, 0x80, 0x41, 0x01, 0xC0,
	0x80, 0x41, 0x00, 0xC1, 0x81, 0x40, 0x01, 0xC0, 0x80, 0x41,
	0x00, 0xC1, 0x81, 0x40, 0x00, 0xC1, 0x81, 0x40, 0x01, 0xC0,
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	0x80, 0x41, 0x00, 0xC1, 0x81, 0x40
};
/* CRC低位字节值表*/
const uint8_t auch_crc_lo[] = {
	0x00, 0xC0, 0xC1, 0x01, 0xC3, 0x03, 0x02, 0xC2, 0xC6, 0x06,
	0x07, 0xC7, 0x05, 0xC5, 0xC4, 0x04, 0xCC, 0x0C, 0x0D, 0xCD,
	0x0F, 0xCF, 0xCE, 0x0E, 0x0A, 0xCA, 0xCB, 0x0B, 0xC9, 0x09,
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	0x43, 0x83, 0x41, 0x81, 0x80, 0x40
};
/*
****************************************************************************************
* TYPEDEFS (类型定义)
****************************************************************************************
*/


/*
****************************************************************************************
* LOCAL VARIABLES (静态变量)
****************************************************************************************
*/


/*
****************************************************************************************
* LOCAL FUNCTIONS DECLARE (静态函数声明)
****************************************************************************************
*/
static void delay_microsecond(uint32_t microsecond);

/*
****************************************************************************************
* LOCAL FUNCTIONS (静态函数)
****************************************************************************************
*/
static void delay_microsecond(uint32_t microsecond)
{
	microsecond *= 42;
	
	for(uint32_t i = 0; i < microsecond; i++)
	{
		;
	}
}

/*
****************************************************************************************
* Function: crc16_list
* Description: crc16校验查表法
* Calls: None
* Called By: None
* Input: *puchmsg    校验数据首地址
*        usdatalen    校验数据个数
* Output: None
* Return: 校验结果
* Author: LeeSong
* Others: None
* date of completion: 2019-02-18
* date of last modify: 2019-02-18
****************************************************************************************
*/
uint16_t crc16_list(uint8_t *puchmsg, uint16_t usdatalen)
{
	uint8_t uch_crc_hi = 0xFF;
	uint8_t uch_crc_lo = 0xFF;
	uint32_t uindex;
	
	while (usdatalen--)
	{
		uindex = uch_crc_hi ^ *puchmsg++;
		uch_crc_hi = uch_crc_lo ^ auch_crc_hi[uindex];
		uch_crc_lo = auch_crc_lo[uindex];
	}
	
	return (uch_crc_hi | uch_crc_lo <<8);
}

/*
****************************************************************************************
* PUBLIC FUNCTIONS (全局函数)
****************************************************************************************
*/

/*
****************************************************************************************
* Function: RS485_UARTConfig
* Description: None
* Input: None
* Output: None
* Return: None
* Author: weihaoMo
* Others: None
* Date of completion: 2020-09-01
* Date of last modify: 2019-09-01
****************************************************************************************
*/
void rs485_uart_config(uint32_t bond)
{
	//GPIO配置
	RCC_AHB1PeriphClockCmd  ( RCC_AHB1Periph_GPIOC, ENABLE ) ; 
	
	GPIO_InitTypeDef  GPIO_InitStruct;//配置参数结构体
	GPIO_InitStruct.GPIO_Pin=GPIO_Pin_6 | GPIO_Pin_7;
	GPIO_InitStruct.GPIO_Mode=GPIO_Mode_AF;
	GPIO_InitStruct.GPIO_OType=GPIO_OType_PP;
	GPIO_InitStruct.GPIO_PuPd=GPIO_PuPd_NOPULL;
	GPIO_InitStruct.GPIO_Speed=GPIO_Speed_2MHz;
	GPIO_Init(GPIOC, &GPIO_InitStruct);	
	GPIO_PinAFConfig (GPIOC,  GPIO_PinSource6,  GPIO_AF_USART6 );
	GPIO_PinAFConfig (GPIOC,  GPIO_PinSource7,  GPIO_AF_USART6 );
	GPIO_PinLockConfig(GPIOC,GPIO_Pin_6 | GPIO_Pin_7);
	
	//USART6配置
	RCC_APB2PeriphClockCmd ( RCC_APB2Periph_USART6,ENABLE ) ;
	
	USART_InitTypeDef   USART_InitStruct ;
	USART_InitStruct.USART_BaudRate=bond;
	USART_InitStruct.USART_WordLength=USART_WordLength_8b ;
	USART_InitStruct.USART_StopBits=USART_StopBits_1 ;
	USART_InitStruct.USART_Parity=USART_Parity_No;
	USART_InitStruct.USART_Mode=USART_Mode_Rx|USART_Mode_Tx;
	USART_InitStruct.USART_HardwareFlowControl=USART_HardwareFlowControl_None;
	USART_Init  ( RS485_UART,&USART_InitStruct) ;
	
	USART_ITConfig( RS485_UART,  USART_IT_RXNE,ENABLE) ;
	USART_ITConfig( RS485_UART,  USART_IT_IDLE,ENABLE) ;

	//配置NVIC
	NVIC_InitTypeDef   NVIC_InitStruct;
	NVIC_InitStruct.NVIC_IRQChannel=RS485_UART_IRQn;
	NVIC_InitStruct.NVIC_IRQChannelPreemptionPriority=2;//响应优先级
	NVIC_InitStruct.NVIC_IRQChannelSubPriority=2;//抢占优先级
	NVIC_InitStruct.NVIC_IRQChannelCmd=ENABLE;
	NVIC_Init  ( &NVIC_InitStruct ) ; 
	
	USART_Cmd( RS485_UART,ENABLE) ;

}



TYPE_RS485_U RS485rev={0};
/*
****************************************************************************************
* Function: RS485_UART_IRQHandler
* Description: None
* Input: None
* Output: None
* Return: None
* Author: weihaoMo
* Others: None
* Date of completion: 2020-09-01
* Date of last modify: 2019-09-01
****************************************************************************************
*/
void RS485_UART_IRQHandler(void)
{
	uint8_t data;
	if(RS485_UART->SR & (0X01<<5))  //接收中断
	{
		RS485rev.RevBuf[RS485rev.RevLen]=RS485_UART->DR;
		RS485rev.RevLen++;

	}
	else if(RS485_UART->SR & (0X01<<4))//空闲中断
	{
		data=RS485_UART->SR;
		data=RS485_UART->DR;
	
		RS485rev.BufLen=RS485rev.RevLen;
		RS485rev.RevLen=0;
		RS485rev.RevOver=1;

	} 

	
}

/*
****************************************************************************************
* Function: RS485_uart_tx_bytes
* Description: None
* Input: TxBuffer：待发送数据缓冲区首地址  
         Length：待发送数据长度（字节）
* Output: None
* Return: None
* Author: weihaoMo
* Others: None
* Date of completion: 2020-09-01
* Date of last modify: 2019-09-01
****************************************************************************************
*/
void rs485_uart_tx_bytes( uint8_t* TxBuffer, uint8_t Length )
{
	while( Length-- )
	{
		while( RESET == USART_GetFlagStatus( RS485_UART, USART_FLAG_TXE ));
		USART_SendData(RS485_UART,  *TxBuffer ); 
		TxBuffer++;
	}
}


/*
****************************************************************************************
* Function: RS485_uart_tx_bytes
* Description: None
* Input: TxBuffer：待发送数据缓冲区首地址  
         Length：待发送数据长度（字节）
* Output: None
* Return: None
* Author: weihaoMo
* Others: None
* Date of completion: 2020-09-01
* Date of last modify: 2019-09-01
****************************************************************************************
*/
void send_rs485_commond(uint8_t *cmd,uint8_t len)
{
	//SEND_RS485_MODE;
	delay_microsecond(3000);
	rs485_uart_tx_bytes( (uint8_t*)cmd, len );
	delay_microsecond(3000);
	//REV_RS485_MODE;
}





